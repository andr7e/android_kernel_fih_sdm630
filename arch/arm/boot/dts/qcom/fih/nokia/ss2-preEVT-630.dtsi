/* SS2 preEVT SDM630 */

/* MemMap parts */
#include "../common/memmap-evb.dtsi"

/* Common DT Info */
#include "common/common_info_sdm_v4.dtsi"

/* SYSTEM parts */
#include "common/system-preEVT-630.dtsi"

/* External LDO control */
#include "ext-reguator/fixed-regulator-EVT-v1.dtsi"

/* Keypad parts */
#include "misc/keypad.dtsi"

/* PMIC parts */

/* GPIO parts */

/* Peripheral */

/* Charging */
#include "charger/charger-evt1-s2.dtsi"

/* Audio */

/* Camera */
#include "camera/camera-ss2-evt.dtsi"

/* Haptic */
#include "misc/haptics_s2.dtsi"

/* SD */
#include "misc/sd-evb.dtsi"

/* Fingerprint */
#include "fingerprint/fingerprint-fpc1020.dtsi"

/* Sensor */
#include "sensors/hallsensor-ah1902-evb.dtsi"

/* Touch */
#include "touch/touch-focaltech8716-s2.dtsi"

/* LCM */
#include "display/dsi-panel-fih-ft8716-ffd-video-s2.dtsi"
//#include "display/dsi-panel-fih-ft8716-1080p-video-pl2.dtsi"
//#include "display/dsi-panel-r69338-1080p-video.dtsi"  //ZZDC sunqiupeng add for bringup PL2 2nd panel@20171226

