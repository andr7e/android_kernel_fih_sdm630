/* Copyright (c) 2017, The Linux Foundation. All rights reserved.
 *
 * This program is free software; you can redistribute it and/or modify
 * it under the terms of the GNU General Public License version 2 and
 * only version 2 as published by the Free Software Foundation.
 *
 * This program is distributed in the hope that it will be useful,
 * but WITHOUT ANY WARRANTY; without even the implied warranty of
 * MERCHANTABILITY or FITNESS FOR A PARTICULAR PURPOSE.  See the
 * GNU General Public License for more details.
 */


/dts-v1/;

#include "sdm630.dtsi"
#include "sdm630-mtp.dtsi"
#include "sdm660-internal-codec-s2.dtsi"
#include "fih/nokia/ss2-preEVT-630.dtsi"
/ {
	model = "Qualcomm Technologies, Inc. SDM 630 PM660 + PM660L MTP, SS2 dvt";
	compatible = "qcom,sdm630-mtp", "qcom,sdm630", "qcom,mtp";
	qcom,board-id = <8 0>;
	qcom,pmic-id = <0x0001001b 0x0101011a 0x0 0x0>,
			<0x0001001b 0x0201011a 0x0 0x0>;
	fih,hw-id = <1 1 0>;
};

&red_led {	
	qcom,ramp-step-ms = <0x80>;
	qcom,max-brightness = <0x55>;
	qcom,duty-ms = <0x14>;
};

&green_led {
	qcom,ramp-step-ms = <128>;
	qcom,start-idx = <0x0>;
	qcom,idx-len = <0x16>;
	qcom,duty-pcts = [01 0a 14 1e 28 32 3c 46 50 5a 64 64 5a 50 46 3c 32 28 1e 14 0a 01];
	qcom,use-blink;
	qcom,max-brightness = <70>;
	qcom,duty-ms = <20>;
};

&blue_led {
	qcom,ramp-step-ms = <128>;
	qcom,start-idx = <0x0>;
	qcom,idx-len = <0x16>;
	qcom,duty-pcts = [01 0a 14 1e 28 32 3c 46 50 5a 64 64 5a 50 46 3c 32 28 1e 14 0a 01];
	qcom,use-blink;
	qcom,max-brightness = <180>;
	qcom,duty-ms = <20>;
};
